## boards/cocolinx/shield/Kconfig.cocolinx_shield
```kconfig
# Copyright (c) 2026 cocolinx
# Copyright (c) 2018-2020 Nordic Semiconductor ASA
# SPDX-License-Identifier: Apache-2.0

config BOARD_COCOLINX_SHIELD
	select SOC_NRF9151_LACA
```

## boards/cocolinx/shield/board.yml
```yaml
board:
  name: cocolinx_shield
  full_name: nRF9151 Shield
  vendor: cocolinx
  socs:
  - name: nrf9151
    variants:
    - name: 'ns'
```
